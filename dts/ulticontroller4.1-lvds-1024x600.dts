/*
 * Copyright (C) 2020 - Ultimaker B.V.
 * Copyright (C) 2020 - Raymond Siudak <raysiudak@gmail.com>
*/

#include "ulticontroller4.0-lvds-1024x600.dts"

&i2c2 {
    panel_touchscreen: ft5426@38 {
        /delete-property/ touchscreen-inverted-x;
        /delete-property/ touchscreen-inverted-y;
    };
};