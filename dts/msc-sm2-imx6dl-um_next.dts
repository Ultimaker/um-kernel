/dts-v1/;
#define IMX6DL_ULTIMAKER 1
#include "imx6dl-pinfunc.h"
#include "imx6dl.dtsi"
#include "msc-sm2-imx6sdl.dtsi"
#include "next-ultimainboard3.1.dtsi"
#include "part201258-ulticontroller3.dtsi"
// following largely irrelevant and - in its curretn form -  requires PWM3 available:
// #include "part1994-ulticontroller.dtsi"

/ {
	model = "Freescale imx6dl on MSC SOM on MSC board - alla Ultimaker";
	compatible = "fsl,imx6dl-MSC-um", "fsl,imx6dl";
	memory: memory {
		reg = <0x10000000 0x80000000>; /* 2 GiB */
	};
#if 0
    /* beeper stuff below not woreking - we must stay off pwm3 whose pins are used  for SPI nRST! */
      beeper {
	  pwm-names = "opinicus-board-beeper";
	  compatible = "pwm-beeper";
	  pwms = <&pwm3 1 500000 0>;
	  status = "okay";
      };
#endif
};
