/*
 * The code contained herein is licensed under the GNU General Public
 * License. You may obtain a copy of the GNU General Public License
 * Version 2 or later at the following locations:
 *
 * http://www.opensource.org/licenses/gpl-license.html
 * http://www.gnu.org/copyleft/gpl.html
 */

#ifdef SMX6_SERIAL_CAMERA
#ifdef smarc_i2c_cam
&smarc_i2c_cam {
	mipi_camera: ov5640@3c {
		compatible = "ovti,ov5640";
		reg = <0x3c>;
		clocks = SMARC_SERIAL_CAMERA_MCLK;
		clock-names = "xclk";
		powerdown-gpios = SMARC_SERIAL_CAMERA_POWER_GPIO;
		reset-gpios = SMARC_SERIAL_CAMERA_RESET_GPIO;

		port {
			#address-cells = <1>;
			#size-cells = <0>;

			ov5640_to_mipi_csi2: endpoint {
				remote-endpoint = <&mipi_csi2_in>;
				clock-lanes = <0>;
				data-lanes = <1 2>;
			};
		};

	};
};
#endif
#endif
