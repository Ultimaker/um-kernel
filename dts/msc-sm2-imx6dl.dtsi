/*
 * Copyright 2017 MSC Technologies GmbH 
 *
 * The code contained herein is licensed under the GNU General Public
 * License. You may obtain a copy of the GNU General Public License
 * Version 2 or later at the following locations:
 *
 * http://www.opensource.org/licenses/gpl-license.html
 * http://www.gnu.org/copyleft/gpl.html
 */
#include "imx6dl-pinfunc.h"
#include "imx6dl.dtsi"
#include "msc-sm2-imx6sdl.dtsi"

/ {
	model = "MSC SMARC i.MX6 DUAL LITE";
	compatible = "msc,imx6dl_SMARC", "fsl,imx6dl";
	memory: memory {
		reg = <0x10000000 0x80000000>; /* 2 GiB */
	};
};
