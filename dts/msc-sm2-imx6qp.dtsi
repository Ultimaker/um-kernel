/*
 * Copyright 2017 MSC Technologies GmbH 
 *
 * The code contained herein is licensed under the GNU General Public
 * License. You may obtain a copy of the GNU General Public License
 * Version 2 or later at the following locations:
 *
 * http://www.opensource.org/licenses/gpl-license.html
 * http://www.gnu.org/copyleft/gpl.html
 */

#include "msc-sm2-imx6qdp.dtsi"

/ {
	model = "MSC SMARC i.MX6QUAD PLUS";
	compatible = "msc,imx6q_SMARC", "fsl,imx6qp";
	memory: memory {
		reg = <0x10000000 0x80000000>;	/* 2GiB */
	};
};
