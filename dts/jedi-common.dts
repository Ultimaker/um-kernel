#include "sun7i-a20-olinuxino-lime2-emmc.dts"

&vcc_csi1 {
    regulator-min-microvolt = <3300000>;
    regulator-max-microvolt = <3300000>;
};

&usb_otg {
    dr_mode = "host";
};

&usbphy {
    /* Unset otg detect pins as we force dr_mode */
    /delete-property/ usb0_id_det-gpio;
    /delete-property/ usb0_vbus_det-gpio;
};
